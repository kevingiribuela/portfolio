/* Pinout definition */
#define MOSFET 13
#define SWITCH 2
#define BUTTON 3

/* Macro functionality definition */
#define JUMP 20
#define LIMIT 500


#include <Arduino.h>


#include <Wire.h>
#include "Adafruit_GFX.h"
#include "Adafruit_SSD1306.h"

#define SCREEN_WIDTH    128
#define SCREEN_HEIGHT   64
#define OLED_RESET      -1 
#define SCREEN_ADDRESS  0x3C

#define CHAR_WIDTHX2  14
#define CHAR_HEIGHX2  16

#define CHAR_WIDTHX1  7
#define CHAR_HEIGHX1  8

const unsigned char PROGMEM logo_bmp[] = {
	// 'Screenshot from 2024-03-15 08-58-43, 128x64px
	0xff, 0xff, 0xff, 0xff, 0xff, 0xff, 0xff, 0xff, 0xff, 0xff, 0xff, 0xff, 0xff, 0xff, 0xff, 0xff, 
	0xff, 0xff, 0xff, 0xff, 0xff, 0xff, 0xff, 0xff, 0xff, 0xff, 0xff, 0xff, 0xff, 0xff, 0xff, 0xff, 
	0xff, 0xff, 0xff, 0xff, 0xff, 0xff, 0xff, 0xe0, 0x7f, 0xff, 0xff, 0xff, 0xff, 0xff, 0xff, 0xff, 
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	0x00, 0x00, 0x00, 0x00, 0x00, 0x00, 0x03, 0xff, 0xff, 0xff, 0xff, 0xff, 0xc0, 0x00, 0x00, 0x00
};

volatile bool increment = false;
volatile bool switch_on = false;
volatile bool quickshift_on = false;
Adafruit_SSD1306 display(SCREEN_WIDTH, SCREEN_HEIGHT, &Wire, OLED_RESET);

void increment_delay_interrupt ();
void switch_interrupt ();
void show_cutoff(int *);
void testdrawbitmap(const unsigned char *);
void textprint(String texto, int X=0, int Y=0, int textsize=2, int on=1);

void setup() {
  pinMode(SWITCH, INPUT);
  pinMode(BUTTON, INPUT);
  pinMode(MOSFET,    OUTPUT);

  attachInterrupt(digitalPinToInterrupt(SWITCH), switch_interrupt, FALLING);
  attachInterrupt(digitalPinToInterrupt(BUTTON), increment_delay_interrupt, FALLING);

  // Set the MOSFET ON
  digitalWrite(MOSFET, HIGH);

  if(!display.begin(SSD1306_SWITCHCAPVCC, SCREEN_ADDRESS)) {
    for(;;);
  }

  // Show logo
  display.clearDisplay();
  testdrawbitmap(logo_bmp);
  display.display();
  delay(4000);

  // Show text
  display.clearDisplay();
  textprint(" Quick\n  shifter",25,15);
  textprint("Kevin Giribuela", 0,6*CHAR_HEIGHX1+3, 1);
  delay(3000);
  display.clearDisplay();
  textprint("Cut-off:");
  textprint("Kevin Giribuela", 0,6*CHAR_HEIGHX1+3, 1);
  textprint("OFF",0,CHAR_HEIGHX2);
}

void loop() {
  int milisec = 0;

  while(1){
    if(increment){
      if(milisec == LIMIT){
        milisec = 0;
        quickshift_on = false;
      }
      else{
        milisec += JUMP;
        quickshift_on = true;
      }
      show_cutoff(&milisec);

      delay(100);
      increment = false;
    }

    if(quickshift_on & switch_on){
      digitalWrite(MOSFET, LOW);
      delay(milisec);
      digitalWrite(MOSFET, HIGH);

      switch_on = false;
    }
  }
}

void show_cutoff(int *milisec){
  int time = *milisec;
  display.clearDisplay();
  textprint("Cut-off:");
  textprint("Kevin Giribuela", 0,6*CHAR_HEIGHX1+3, 1);
  if(time!=0){
    textprint((String)time+" ms", 0, CHAR_HEIGHX2);
  }
  else{
    textprint("OFF   ", 0, CHAR_HEIGHX2);
  }

}

void switch_interrupt() {
  if(!switch_on){
    switch_on = true;
  }
}

void increment_delay_interrupt(){
  if(!increment){
      increment = true;
  }
}

void textprint(String texto, int X, int Y, int textsize, int on){
  display.setTextSize(textsize);
  if(on){
    display.setTextColor(SSD1306_WHITE);
  }
  else{
    display.setTextColor(SSD1306_BLACK);;
  }
  display.setCursor(X, Y);
  display.println(texto);
  display.display();
}

void testdrawbitmap(const unsigned char *logo_bmp) {
  display.clearDisplay();

  display.drawBitmap(
    (display.width()  - SCREEN_WIDTH ) / 2,
    (display.height() - SCREEN_HEIGHT) / 2,
    logo_bmp, SCREEN_WIDTH, SCREEN_HEIGHT, 1);
  display.display();
}